## main/Kconfig.projbuild
```kconfig
menu "Typheye Car Server"

config TCAR_LED_GPIO
    int "Status LED GPIO"
    default 21
    help
        Seeed Studio XIAO ESP32S3 USER_LED is GPIO21.

config TCAR_LED_ACTIVE_LOW
    bool "Status LED is active low"
    default y
    help
        XIAO user LED is driven as active-low on common board revisions.

endmenu
```

## sdkconfig.defaults
```kconfig
CONFIG_IDF_TARGET="esp32s3"
CONFIG_LWIP_IP_FORWARD=y
CONFIG_LWIP_IPV4_NAPT=y
CONFIG_ESP_WIFI_SOFTAP_SUPPORT=y
CONFIG_ESP_WIFI_STA_DISCONNECTED_PM_ENABLE=n
CONFIG_HTTPD_MAX_REQ_HDR_LEN=1024
CONFIG_HTTPD_MAX_URI_LEN=512
```
